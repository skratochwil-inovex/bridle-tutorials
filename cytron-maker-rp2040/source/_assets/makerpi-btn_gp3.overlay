/*
 * Copyright (c) 2024 TiaC Systems
 * SPDX-License-Identifier: Apache-2.0
 */

/ {
	aliases {
		sw0 = &btn_gp3;
	};
};

&gpio_keys {
	btn_gp3: btn_3 {
		gpios = <&gpio0 3 GPIO_ACTIVE_HIGH>;
		label = "BTN3";
	};
};
